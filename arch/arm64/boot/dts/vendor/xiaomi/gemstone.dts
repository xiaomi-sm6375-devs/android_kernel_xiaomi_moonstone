#include "../qcom/blair.dts"
#include "gemstone-audio.dts"
#include "gemstone-camera.dts"
#include "gemstone-memory.dts"
#include "gemstone-pinctrl.dts"
#include "gemstone-qupv3.dts"
#include "gemstone-regulators.dts"

&qcom {
        /delete-property/ mem-type;
        pmsg-size = <0x100000>;
        console-size = <0x100000>;
};
